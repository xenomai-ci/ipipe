## arch/powerpc/platforms/pasemi/Kconfig
```kconfig
config PPC_PASEMI
	depends on PPC_MULTIPLATFORM && PPC64
	bool "PA Semi SoC-based platforms"
	default n
	select MPIC
	select PPC_UDBG_16550
	select PPC_NATIVE
	help
	  This option enables support for PA Semi's PWRficient line
	  of SoC processors, including PA6T-1682M

menu "PA Semi PWRficient options"
	depends on PPC_PASEMI

config PPC_PASEMI_IOMMU
	bool "PA Semi IOMMU support"
	depends on PPC_PASEMI
	help
	  IOMMU support for PA6T-1682M

config PPC_PASEMI_L2RAM
	depends on PPC_PASEMI
	bool "PA Semi L2 as RAM support"
	default y
	help
	  L2 as RAM support for PA6T-1682M

config PPC_PASEMI_MDIO
	depends on PHYLIB
	tristate "MDIO support via GPIO"
	default y
	help
	  Driver for MDIO via GPIO on PWRficient platforms

config PPC_PASEMI_A2_WORKAROUNDS
	bool "Workarounds for bugs in version A2 of PA6T-1682M processor."
	depends on PPC_PASEMI
	default n
	help
	  A2 is an early version of PA Semi PA6T-1682M processor. It has some 
	  bugs that will be likely fixed in future versions of the chip. This
	  option enables workarounds for these bugs.

config ELECTRA_IDE
      tristate "Electra IDE driver"
      default y
      depends on PPC_PASEMI && ATA
      select PATA_PLATFORM
      help
	This includes driver support for the Electra on-board IDE
	interface.

endmenu
```

## async_tx/Kconfig
```kconfig
menuconfig ASYNC_CORE
	tristate "Asynchronous Bulk Memory Transfers/Transforms"
	default n
	---help---
	  This enables the async_tx interface layer for dma (offload) engines.
	  Subsystems coded to this api will use offload engines for bulk memory
	  operations (e.g. memcpy, memset, xor...).  When an offload engine is not
	  available the interface will implicitly fall back to a software
	  implementation of the operation.

	  If unsure, say N

if ASYNC_CORE

config ASYNC_MEMCPY
	default m
	tristate "async_memcpy support"

config ASYNC_XOR
	default m
	tristate "async_xor support"

config ASYNC_MEMSET
	default m
	tristate "async_memset support"

config ASYNC_PQXOR
	default m
	tristate "async_pqxor support"

config ASYNC_R6RECOV
	default m
	tristate "async_r6recovery support"

endif
```

## drivers/dma/Kconfig
```kconfig
#
# DMA engine configuration
#

menuconfig DMADEVICES
	bool "DMA Engine support"
	depends on (PCI && X86) || ARCH_IOP32X || ARCH_IOP33X || ARCH_IOP13XX || PPC
	depends on !HIGHMEM64G
	help
	  DMA engines can do asynchronous data transfers without
	  involving the host CPU.  Currently, this framework can be
	  used to offload memory copies in the network stack and
	  RAID operations in the MD driver.

if DMADEVICES

comment "DMA Devices"

config INTEL_IOATDMA
	tristate "Intel I/OAT DMA support"
	depends on PCI && X86
	select DMA_ENGINE
	select DCA
	help
	  Enable support for the Intel(R) I/OAT DMA engine present
	  in recent Intel Xeon chipsets.

	  Say Y here if you have such a chipset.

	  If unsure, say N.

config INTEL_IOP_ADMA
	tristate "Intel IOP ADMA support"
	depends on ARCH_IOP32X || ARCH_IOP33X || ARCH_IOP13XX
	select DMA_ENGINE
	help
	  Enable support for the Intel(R) IOP Series RAID engines.

config AMCC_PPC440SPE_ADMA
	tristate "AMCC PPC440SPe ADMA support"
	depends on 440SPE || 440SP
	select ASYNC_CORE
	select DMA_ENGINE
	select ARCH_HAS_ASYNC_TX_FIND_CHANNEL
	default y
	---help---
	  Enable support for the AMCC PPC440SPe RAID engines.

config FSL_DMA
	tristate "Freescale Elo and Elo Plus DMA support"
	depends on FSL_SOC
	select DMA_ENGINE
	---help---
	  Enable support for the Freescale Elo and Elo Plus DMA controllers.
	  The Elo is the DMA controller on some 82xx and 83xx parts, and the
	  Elo Plus is the DMA controller on 85xx and 86xx parts.

config MV_XOR
	bool "Marvell XOR engine support"
	depends on PLAT_ORION
	select DMA_ENGINE
	---help---
	  Enable support for the Marvell XOR engine.

config MX3_IPU
	bool "MX3x Image Processing Unit support"
	depends on ARCH_MX3
	select DMA_ENGINE
	default y
	help
	  If you plan to use the Image Processing unit in the i.MX3x, say
	  Y here. If unsure, select Y.

config MX3_IPU_IRQS
	int "Number of dynamically mapped interrupts for IPU"
	depends on MX3_IPU
	range 2 137
	default 4
	help
	  Out of 137 interrupt sources on i.MX31 IPU only very few are used.
	  To avoid bloating the irq_desc[] array we allocate a sufficient
	  number of IRQ slots and map them dynamically to specific sources.

config ARCH_HAS_ASYNC_TX_FIND_CHANNEL
	bool

config DMA_ENGINE
	bool

comment "DMA Clients"
	depends on DMA_ENGINE

config NET_DMA
	bool "Network: TCP receive copy offload"
	depends on DMA_ENGINE && NET
	help
	  This enables the use of DMA engines in the network stack to
	  offload receive copy-to-user operations, freeing CPU cycles.
	  Since this is the main user of the DMA engine, it should be enabled;
	  say Y here.

endif
```

## drivers/net/fec_mpc52xx/Kconfig
```kconfig
menu "MPC5200 Networking Options"
	depends PPC_MPC52xx && NET_ETHERNET

config FEC_MPC52xx
	bool "FEC Ethernet"
	depends on NET_ETHERNET
	select PPC_BESTCOMM
	select CRC32
	---help---
	  This option enables support for the MPC5200's on-chip
	  Fast Ethernet Controller

config USE_MDIO
	bool "Use external Ethernet MII PHY"
	select MII
	depends FEC_MPC52xx
	---help---
	  The MPC5200's FEC can connect to the Ethernet either with
	  an external MII PHY chip or 10 Mbps 7-wire interface 
	  (Motorola? industry standard).
	  If your board uses an external PHY, say y, else n.

config FEC_AM79C874
	bool "Use AMD Am79C874 external PHY"
	depends on USE_MDIO
	default y if PPC_MOTIONPRO
	---help---
	Include support for AMD Am79C874 PHY chip.

config FEC_79C874_125TRANS
	bool "Use 1.25:1 transformer ratio"
	depends on FEC_AM79C874
	default n if PPC_MOTIONPRO
	---help---
	From chip specification: AMD Am79C874 PHY can use 1:1 isolation
	transformers or 1.25:1 isolation transformers. 1.25:1 isolation
	transformers provide 20% lower transmit power consumption. Select this
	option to use the 1.25:1 ratio, otherwise the 1:1 ratio will be used.
	This feature depends on the state of the GPIO[1]/TP125 ping during the
	rising edge of reset. See the "PIN DESCRIPTIONS" section in the
	"Am79C874 NetPHYTM-1LP Low Power 10/100-TX/FX Ethernet Transceiver"
	document.

endmenu
```

## kernel/ipipe/Kconfig
```kconfig
config IPIPE
	bool "Interrupt pipeline"
	default y
	---help---
	  Activate this option if you want the interrupt pipeline to be
	  compiled in.

config IPIPE_CORE
	def_bool y
	depends on IPIPE

config IPIPE_LEGACY
	bool "I-pipe legacy interface"
	depends on IPIPE
	default y
	---help---
	  Activate this option if you want to control the interrupt
	  pipeline via the legacy interface.

config IPIPE_DELAYED_ATOMICSW
       bool
       depends on IPIPE
       default n

config IPIPE_UNMASKED_CONTEXT_SWITCH
       bool
       depends on IPIPE
       default n

config HAVE_IPIPE_HOSTRT
       bool
```
